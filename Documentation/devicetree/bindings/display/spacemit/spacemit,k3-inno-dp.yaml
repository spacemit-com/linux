## Documentation/devicetree/bindings/display/spacemit/spacemit,k3-inno-dp.yaml
```yaml
# SPDX-License-Identifier: (GPL-2.0-only OR BSD-2-Clause)
%YAML 1.2
---
$id: http://devicetree.org/schemas/display/spacemit/spacemit,k3-inno-dp.yaml#
$schema: http://devicetree.org/meta-schemas/core.yaml#

title: SpacemiT K3 Innosilicon DisplayPort / embedded DisplayPort Controller

maintainers:
  - Cody Kang <codykang.hk@gmail.com>

description:
  Innosilicon DisplayPort transmit controller integrated in the SpacemiT K3
  SoC. The K3 has two instances of the same block sharing one compatible;
  each acts as embedded or external DisplayPort depending on whether its
  output port drives a panel or a connector.

properties:
  compatible:
    const: spacemit,k3-inno-dp

  reg:
    maxItems: 1

  interrupts:
    maxItems: 1
    description: Link and hot-plug events.

  clocks:
    items:
      - description: Pixel clock for the controller.
      - description:
          Pixel clock generated by the DP PHY PLL; the pixel clock above is
          parented onto it in use.

  clock-names:
    items:
      - const: pxclk
      - const: pll

  resets:
    maxItems: 1
    description: Controller-wide reset signal.

  phys:
    maxItems: 1
    description: Phandle to the K3 Innosilicon DP PHY.

  phy-names:
    items:
      - const: dp

  ports:
    $ref: /schemas/graph.yaml#/properties/ports

    properties:
      port@0:
        $ref: /schemas/graph.yaml#/properties/port
        description: Video input from the DPU.

      port@1:
        $ref: /schemas/graph.yaml#/properties/port
        description: Output to the panel or to the DisplayPort connector.

    required:
      - port@0
      - port@1

  aux-bus:
    $ref: /schemas/display/dp-aux-bus.yaml#
    description:
      The DisplayPort AUX bus. Present when the output drives an embedded
      panel, which is described as a child of this node and identifies itself
      over AUX. Absent when the output is a connector.

  phy:
    $ref: /schemas/phy/spacemit,k3-inno-dp-phy.yaml#
    description:
      The DisplayPort PHY. Its registers live inside this controller's
      register window, so it is described here as a child node.

required:
  - compatible
  - reg
  - interrupts
  - clocks
  - clock-names
  - resets
  - phys
  - phy-names
  - ports

additionalProperties: false

examples:
  - |
    #include <dt-bindings/clock/spacemit,k3-clocks.h>
    #include <dt-bindings/reset/spacemit,k3-resets.h>
    #include <dt-bindings/interrupt-controller/irq.h>

    soc {
        #address-cells = <2>;
        #size-cells = <2>;

        edp@cac84000 {
            compatible = "spacemit,k3-inno-dp";
            reg = <0x0 0xcac84000 0x0 0x4000>;
            interrupts = <132 IRQ_TYPE_LEVEL_HIGH>;
            clocks = <&syscon_apmu CLK_APMU_EDP0_PXCLK>, <&edp0_phy>;
            clock-names = "pxclk", "pll";
            resets = <&syscon_apmu RESET_APMU_EDP0>;
            phys = <&edp0_phy>;
            phy-names = "dp";

            edp0_phy: phy {
                compatible = "spacemit,k3-inno-dp-phy";
                #phy-cells = <0>;
                #clock-cells = <0>;
                clock-output-names = "edp0_pll_pxclk";
            };

            ports {
                #address-cells = <1>;
                #size-cells = <0>;

                port@0 {
                    reg = <0>;
                    endpoint {
                        remote-endpoint = <&dpu0_out>;
                    };
                };

                port@1 {
                    reg = <1>;
                    endpoint {
                        remote-endpoint = <&panel_in>;
                    };
                };
            };
        };
    };
```

## Documentation/devicetree/bindings/display/spacemit/spacemit,k3-saturn-dpu.yaml
```yaml
# SPDX-License-Identifier: (GPL-2.0-only OR BSD-2-Clause)
%YAML 1.2
---
$id: http://devicetree.org/schemas/display/spacemit/spacemit,k3-saturn-dpu.yaml#
$schema: http://devicetree.org/meta-schemas/core.yaml#

title: SpacemiT K3 Saturn Display Processing Unit

maintainers:
  - Cody Kang <codykang.hk@gmail.com>

description:
  The Saturn DPU is the display processing unit of the SpacemiT K3 SoC. It
  composes the display planes and drives the timing for one display path. Its
  output goes to a DisplayPort or embedded DisplayPort controller. The K3 has
  two instances.

properties:
  compatible:
    const: spacemit,k3-saturn-dpu

  reg:
    maxItems: 1

  interrupts:
    items:
      - description: Online (live display) compose path.
      - description: Offline (writeback) compose path.

  interrupt-names:
    items:
      - const: online
      - const: offline

  clocks:
    items:
      - description: Pixel clock.
      - description: Memory clock for the compose pipeline.
      - description: AXI bus clock.
      - description: DSI escape clock.
      - description: DSC clock.

  clock-names:
    items:
      - const: pxclk
      - const: mclk
      - const: aclk
      - const: escclk
      - const: dscclk

  resets:
    items:
      - description: Memory clock domain.
      - description: LCD domain, shared with the downstream controller.
      - description: DSI escape clock domain.
      - description: AXI clock domain.
      - description: DSC domain.

  reset-names:
    items:
      - const: mclk
      - const: lcd
      - const: esc
      - const: aclk
      - const: dsc

  ports:
    $ref: /schemas/graph.yaml#/properties/ports

    properties:
      port@0:
        $ref: /schemas/graph.yaml#/properties/port
        description: Video output to the DisplayPort or eDP controller.

    required:
      - port@0

required:
  - compatible
  - reg
  - interrupts
  - interrupt-names
  - clocks
  - clock-names
  - resets
  - reset-names
  - ports

additionalProperties: false

examples:
  - |
    #include <dt-bindings/clock/spacemit,k3-clocks.h>
    #include <dt-bindings/reset/spacemit,k3-resets.h>
    #include <dt-bindings/interrupt-controller/irq.h>

    soc {
        #address-cells = <2>;
        #size-cells = <2>;

        dpu@c0340000 {
            compatible = "spacemit,k3-saturn-dpu";
            reg = <0x0 0xc0340000 0x0 0x54000>;
            interrupts = <90 IRQ_TYPE_LEVEL_HIGH>,
                         <89 IRQ_TYPE_LEVEL_HIGH>;
            interrupt-names = "online", "offline";
            clocks = <&syscon_apmu CLK_APMU_LCD_PXCLK>,
                     <&syscon_apmu CLK_APMU_LCD_MCLK>,
                     <&syscon_apmu CLK_APMU_DPU_ACLK>,
                     <&syscon_apmu CLK_APMU_DSI_ESC>,
                     <&syscon_apmu CLK_APMU_LCD_DSC>;
            clock-names = "pxclk", "mclk", "aclk", "escclk", "dscclk";
            resets = <&syscon_apmu RESET_APMU_LCD_MCLK>,
                     <&syscon_apmu RESET_APMU_LCD>,
                     <&syscon_apmu RESET_APMU_DSI_ESC>,
                     <&syscon_apmu RESET_APMU_DPU_ACLK>,
                     <&syscon_apmu RESET_APMU_LCD_DSCCLK>;
            reset-names = "mclk", "lcd", "esc", "aclk", "dsc";

            ports {
                #address-cells = <1>;
                #size-cells = <0>;

                port@0 {
                    reg = <0>;
                    endpoint {
                        remote-endpoint = <&edp0_in>;
                    };
                };
            };
        };
    };
```

## Documentation/devicetree/bindings/phy/spacemit,k3-inno-dp-phy.yaml
```yaml
# SPDX-License-Identifier: (GPL-2.0-only OR BSD-2-Clause)
%YAML 1.2
---
$id: http://devicetree.org/schemas/phy/spacemit,k3-inno-dp-phy.yaml#
$schema: http://devicetree.org/meta-schemas/core.yaml#

title: SpacemiT K3 Innosilicon DisplayPort PHY

maintainers:
  - Cody Kang <codykang.hk@gmail.com>

description:
  Innosilicon four-lane DisplayPort transmit PHY integrated in the SpacemiT
  K3 SoC, one per DisplayPort controller. Its registers are interleaved with
  the controller's own inside a single register window, so it is described as
  a child of the controller and owns neither a reg nor a reset.

  The PHY provides the pixel clock its PLL generates, which the APMU
  pixel-clock mux takes as one of its inputs.

properties:
  compatible:
    const: spacemit,k3-inno-dp-phy

  "#phy-cells":
    const: 0

  "#clock-cells":
    const: 0

  clock-output-names:
    maxItems: 1

required:
  - compatible
  - "#phy-cells"
  - "#clock-cells"

additionalProperties: false

examples:
  - |
    phy {
        compatible = "spacemit,k3-inno-dp-phy";
        #phy-cells = <0>;
        #clock-cells = <0>;
        clock-output-names = "edp0_pll_pxclk";
    };
```

## Documentation/devicetree/bindings/power/spacemit,power-controller.yaml
```yaml
# SPDX-License-Identifier: (GPL-2.0-only OR BSD-2-Clause)
%YAML 1.2
---
$id: http://devicetree.org/schemas/power/spacemit,power-controller.yaml#
$schema: http://devicetree.org/meta-schemas/core.yaml#

title: SpacemiT Power Domains Controller

maintainers:
  - Yixun Lan <dlan@kernel.org>

description: |
  SpacemiT processors include support for multiple power domains which can be
  powered on/off by software based on different application scenes to save power.

properties:
  compatible:
    enum:
      - spacemit,k1-power-controller
      - spacemit,k3-power-controller

  '#power-domain-cells':
    const: 1

  spacemit,apmu:
    $ref: /schemas/types.yaml#/definitions/phandle
    description:
      A phandle to APMU syscon to control registers for power domain

required:
  - compatible
  - '#power-domain-cells'
  - spacemit,apmu

additionalProperties: false

examples:
  - |
    power-controller {
            compatible = "spacemit,k1-power-controller";
            spacemit,apmu = <&syscon_apmu>;
            #power-domain-cells = <1>;
    };
```

## Documentation/devicetree/bindings/ufs/spacemit,k3-ufshc.yaml
```yaml
# SPDX-License-Identifier: (GPL-2.0-only OR BSD-2-Clause)
%YAML 1.2
---
$id: http://devicetree.org/schemas/ufs/spacemit,k3-ufshc.yaml#
$schema: http://devicetree.org/meta-schemas/core.yaml#

title: SpacemiT K3 SoC UFS Host Controller

maintainers:
  - Yixun Lan <dlan@kernel.org>

properties:
  compatible:
    const: spacemit,k3-ufshc

  reg:
    maxItems: 1

  clocks:
    maxItems: 2

  clock-names:
    items:
      - const: aclk
      - const: ref_clk

  resets:
    maxItems: 1

required:
  - compatible
  - reg
  - clocks
  - clock-names
  - resets

allOf:
  - $ref: ufs-common.yaml

unevaluatedProperties: false

examples:
  - |
    #include <dt-bindings/clock/spacemit,k3-clocks.h>
    #include <dt-bindings/reset/spacemit,k3-resets.h>
    #include <dt-bindings/interrupt-controller/irq.h>
    ufs@c0e00000 {
        compatible = "spacemit,k3-ufshc";
        reg = <0xc0e00000 0x40000>;
        clocks = <&syscon_apmu CLK_APMU_UFS_ACLK>,
                 <&syscon_apmu CLK_APMU_UFS_REFCLK>;
        clock-names = "aclk", "ref_clk";
        resets = <&syscon_apmu RESET_APMU_UFS_ACLK>;
        interrupts = <135 IRQ_TYPE_LEVEL_HIGH>;
        lanes-per-direction = <2>;
    };
```

## drivers/gpu/drm/spacemit/Kconfig
```kconfig
# SPDX-License-Identifier: GPL-2.0

config DRM_SPACEMIT
	tristate "DRM support for SpacemiT display controllers"
	depends on DRM && OF && MMU
	depends on ARCH_SPACEMIT || COMPILE_TEST
	select DRM_CLIENT_SELECTION
	select DRM_KMS_HELPER
	select DRM_GEM_SHMEM_HELPER
	select REGMAP_MMIO
	select VIDEOMODE_HELPERS
	help
	  Choose this option if you have a SpacemiT SoC with the Saturn
	  display processing unit, such as the K3. The DPU scans out
	  framebuffers through its private display MMU and feeds a
	  DisplayPort or embedded DisplayPort controller.

	  If M is selected the module will be called spacemit-drm.

config SPACEMIT_INNO_DP
	tristate "SpacemiT Innosilicon DP/eDP controller support"
	depends on DRM_SPACEMIT
	imply PHY_SPACEMIT_K3_INNO_DP
	select GENERIC_PHY
	select DRM_PANEL
	select DRM_BRIDGE_CONNECTOR
	select DRM_DISPLAY_HELPER
	select DRM_DISPLAY_DP_HELPER
	select DRM_DISPLAY_DP_AUX_BUS
	help
	  Choose this option to enable the Innosilicon DisplayPort /
	  embedded DisplayPort transmitter integrated in SpacemiT SoCs.
	  The controller sits downstream of the Saturn DPU and drives an
	  eDP panel (discovered over the DP AUX bus) or an external
	  DisplayPort connector.

	  If M is selected the module will be called spacemit-inno-dp.
```

## drivers/pmdomain/spacemit/Kconfig
```kconfig
# SPDX-License-Identifier: GPL-2.0-only

menu "SpacemiT PM Domains"

config SPACEMIT_PM_DOMAINS
	tristate "PM Domain driver for SpacemiT SoC"
	depends on ARCH_SPACEMIT || COMPILE_TEST
	depends on PM && OF
	select PM_GENERIC_DOMAINS
	select PM_GENERIC_DOMAINS_OF
	select AUXILIARY_BUS
	help
	  This driver enables power domain management for the SpacemiT
	  SoC. On the SoC there are number of power domains available,
	  which can be managed independently. For example VPU, GPU, LCD,
	  and Audio reside in their own power domains which can be
	  turned on/off.

	  Say y to enable device power management through PM domains.

endmenu
```

## drivers/soc/spacemit/Kconfig
```kconfig
# SPDX-License-Identifier: GPL-2.0-only

config SPACEMIT_HMP
	bool "Spacemit HMP support"
	depends on SMP && ARCH_SPACEMIT
	help
	  Say y here to enable the HMP feature support.
	  This feature categorizes the CPU cores within the
	  SOC into two distinct types, each running different
	  types of threads.
```
