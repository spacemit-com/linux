## Documentation/devicetree/bindings/clock/spacemit,k1-ccu.yaml
```yaml
# SPDX-License-Identifier: GPL-2.0-only OR BSD-2-Clause
%YAML 1.2
---
$id: http://devicetree.org/schemas/clock/spacemit,k1-ccu.yaml#
$schema: http://devicetree.org/meta-schemas/core.yaml#

title: Spacemit K1 SoC Clock Controller

maintainers:
  - Haylen Chu <heylenay@4d2.org>

properties:
  compatible:
    enum:
      - spacemit,k1-ccu-apbs
      - spacemit,k1-ccu-mpmu
      - spacemit,k1-ccu-apbc
      - spacemit,k1-ccu-apmu

  clocks:
    maxItems: 4

  clock-names:
    items:
      - const: osc
      - const: vctcxo_1m
      - const: vctcxo_3m
      - const: vctcxo_24m

  spacemit,mpmu:
    $ref: /schemas/types.yaml#/definitions/phandle
    description:
      Phandle to the syscon managing "Main PMU (MPMU)" registers. It is used to
      check PLL lock status.

  "#clock-cells":
    const: 1
    description:
      See <dt-bindings/clock/spacemit,k1-ccu.h> for valid indices.

required:
  - compatible
  - clocks
  - clock-names
  - "#clock-cells"

allOf:
  - if:
      properties:
        compatible:
          contains:
            const: spacemit,k1-ccu-apbs
    then:
      required:
        - spacemit,mpmu
    else:
      properties:
        spacemit,mpmu: false

additionalProperties: false
```

## Documentation/devicetree/bindings/gpio/spacemit,k1-gpio.yaml
```yaml
# SPDX-License-Identifier: (GPL-2.0-only OR BSD-2-Clause)
%YAML 1.2
---
$id: http://devicetree.org/schemas/gpio/spacemit,k1-gpio.yaml#
$schema: http://devicetree.org/meta-schemas/core.yaml#

title: SpacemiT K1 GPIO controller

maintainers:
  - Yixun Lan <dlan@gentoo.org>

description:
  The controller's registers are organized as sets of eight 32-bit
  registers with each set of port controlling 32 pins.  A single
  interrupt line is shared for all of the pins by the controller.
  Each port will be represented as child nodes with the generic
  GPIO-controller properties in this bindings file.

properties:
  $nodename:
    pattern: "^gpio@[0-9a-f]+$"

  compatible:
    const: spacemit,k1-gpio

  reg:
    maxItems: 1

  "#address-cells":
    const: 1

  "#size-cells":
    const: 0

patternProperties:
  "^gpio-port@[0-9a-f]+$":
    type: object
    properties:
      compatible:
        const: spacemit,k1-gpio-port

      reg:
        maxItems: 1

      gpio-controller: true

      "#gpio-cells":
        const: 2

      gpio-ranges: true

      interrupts:
        maxItems: 1

      interrupt-controller: true

      "#interrupt-cells":
        const: 2
        description:
          The first cell is the GPIO number, the second should specify interrupt
          flag. The controller does not support level interrupts, so flags of
          IRQ_TYPE_LEVEL_HIGH, IRQ_TYPE_LEVEL_LOW should not be used.
          Refer <dt-bindings/interrupt-controller/irq.h> for valid flags.

    required:
      - compatible
      - reg
      - gpio-controller
      - "#gpio-cells"

    dependencies:
      interrupt-controller: [ interrupts ]

    additionalProperties: false

additionalProperties: false

required:
  - compatible
  - reg
  - "#address-cells"
  - "#size-cells"

examples:
  - |
    gpio: gpio@d4019000 {
      compatible = "spacemit,k1-gpio";
      reg = <0xd4019000 0x800>;
      #address-cells = <1>;
      #size-cells = <0>;

      port0: gpio-port@0 {
        compatible = "spacemit,k1-gpio-port";
        reg = <0>;
        gpio-controller;
        #gpio-cells = <2>;
        interrupt-parent = <&plic>;
        interrupts = <58>;
        interrupt-controller;
        #interrupt-cells = <2>;
        gpio-ranges = <&pinctrl 0 0 32>;
      };

      port1: gpio-port@4 {
        compatible = "spacemit,k1-gpio-port";
        reg = <4>;
        gpio-controller;
        #gpio-cells = <2>;
        interrupt-parent = <&plic>;
        interrupts = <58>;
        interrupt-controller;
        #interrupt-cells = <2>;
        gpio-ranges = <&pinctrl 0 32 32>;
      };
    };
...
```

## Documentation/devicetree/bindings/soc/spacemit/spacemit,k1-syscon.yaml
```yaml
# SPDX-License-Identifier: (GPL-2.0-only OR BSD-2-Clause)
%YAML 1.2
---
$id: http://devicetree.org/schemas/soc/spacemit/spacemit,k1-syscon.yaml#
$schema: http://devicetree.org/meta-schemas/core.yaml#

title: Spacemit K1 SoC System Controller

maintainers:
  - Haylen Chu <heylenay@4d2.org>

description:
  The Spacemit K1 SoC system controller provides access to shared register files
  for related SoC modules, such as clock controller and reset controller.

properties:
  compatible:
    items:
      - enum:
          - spacemit,k1-apbc-syscon
          - spacemit,k1-apbs-syscon
          - spacemit,k1-apmu-syscon
          - spacemit,k1-mpmu-syscon
      - const: syscon
      - const: simple-mfd

  reg:
    maxItems: 1

  clock-controller:
    $ref: /schemas/clock/spacemit,k1-ccu.yaml#
    type: object

required:
  - compatible
  - reg

additionalProperties: false

examples:
  - |
    system-controller@d4050000 {
        compatible = "spacemit,k1-mpmu-syscon", "syscon", "simple-mfd";
        reg = <0xd4050000 0x209c>;

        clock-controller {
            compatible = "spacemit,k1-ccu-mpmu";
            clocks = <&osc_32k>, <&vctcxo_1m>, <&vctcxo_3m>, <&vctcxo_24m>;
            clock-names = "osc", "vctcxo_1m", "vctcxo_3m", "vctcxo_24m";
            #clock-cells = <1>;
        };
    };
```

## drivers/clk/spacemit/Kconfig
```kconfig
# SPDX-License-Identifier: GPL-2.0-only

config SPACEMIT_CCU
	tristate "Clock support for Spacemit SoCs"
	default y
	depends on ARCH_SPACEMIT || COMPILE_TEST
	select MFD_SYSCON
	help
	  Say Y to enable clock controller unit support for Spacemit SoCs.

if SPACEMIT_CCU

config SPACEMIT_K1_CCU
	tristate "Support for Spacemit K1 SoC"
	default y
	depends on ARCH_SPACEMIT || COMPILE_TEST
	help
	  Support for clock controller unit in Spacemit K1 SoC.

endif
```

## drivers/net/ethernet/spacemit/Kconfig
```kconfig
config NET_VENDOR_SPACEMIT
	bool "Spacemit devices"
	default y
	depends on ARCH_SPACEMIT
	help
	  If you have a network (Ethernet) chipset belonging to this class,
	  say Y.

	  Note that the answer to this question does not directly affect
	  the kernel: saying N will just cause the configurator to skip all
	  the questions regarding Spacemit chipsets. If you say Y, you will
	  be asked for your specific chipset/driver in the following questions.

if NET_VENDOR_SPACEMIT

config K1X_EMAC
	bool "k1-x Emac Driver"
	depends on ARCH_SPACEMIT
	select PHYLIB
	help
	  This Driver support Spacemit k1-x Ethernet MAC
	  Say Y to enable support for the Spacemit Ethernet.

endif # NET_VENDOR_SPACEMIT
```
